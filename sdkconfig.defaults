## sdkconfig.defaults
```kconfig
# Bluetooth
CONFIG_BT_ENABLED=y
CONFIG_BT_BLUEDROID_ENABLED=y
CONFIG_BT_CLASSIC_ENABLED=y
CONFIG_BT_BLE_ENABLED=n
CONFIG_BT_HID_ENABLED=y
CONFIG_BT_HID_HOST_ENABLED=y
CONFIG_BT_SSP_ENABLED=y
CONFIG_BTDM_CTRL_MODE_BR_EDR_ONLY=y

# I2C
CONFIG_I2C_ISR_IRAM_SAFE=n

# Stack sizes (BT needs headroom)
CONFIG_ESP_MAIN_TASK_STACK_SIZE=8192
CONFIG_BT_BTU_TASK_STACK_SIZE=8192

# Logging
CONFIG_LOG_DEFAULT_LEVEL_INFO=y
CONFIG_LOG_MAXIMUM_LEVEL_DEBUG=y

# Partition table
CONFIG_PARTITION_TABLE_SINGLE_APP=y
```
